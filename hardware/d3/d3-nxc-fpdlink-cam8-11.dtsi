/*
 * Copyright (c) 2020, D3 Engineering. All rights reserved.
 *
 * This program is free software; you can redistribute it and/or modify
 * it under the terms of the GNU General Public License as published by
 * the Free Software Foundation; version 2 of the License.
 *
 * This program is distributed in the hope that it will be useful, but WITHOUT
 * ANY WARRANTY; without even the implied warranty of MERCHANTABILITY or
 * FITNESS FOR A PARTICULAR PURPOSE.  See the GNU General Public License for
 * more details.
 */

#include "d3-reset-full.dtsi"

#define STATUS disabled
#define ORIENTATION 1

#define IOVDD_SUPPLY <&p3668_vdd_1v8_sd>
#define AVDD_SUPPLY <&p3668_vdd_1v8_sd>
#define RESET_PIN <&nxc_fg 98 GPIO_ACTIVE_LOW>

#define TEGRA_SINTERFACE serial_e
#define CSI_PORT 4
#define CSI_LANES 4
#define VI_INPUT_STREAM 4

#define I2C_BASE_PATH /proc/device-tree/i2c@3180000/tca9546@77/i2c@2
#define DES_BUS 2
#define DES_BUS_NODE i2c_mux_bus_2
#define DES_ADDR 3d
#define EEPROM_ADDR 54

#include "templated-deserializers/d3-des-ub960-template.dtsi"

/* Port 0 */
#include "d3-reset-port.dtsi"
#define PORT_VCID 0
#define DES_LINK 0
#define PORT_IDX 8
#define POSITION PORT_IDX
#define ENDPOINT_A 16
#define ENDPOINT_B 17
#define SER_BUS 48
#define ATR_SER_ADDR 48
#define ATR_IMG_ADDR 68
#define ATR_GPIO_EXP_ADDR 78
#define ATR_EEPROM_ADDR 6C

#include "d3-nxc-fpdlink-cameras.dtsi"

/* Port 1 */
#include "d3-reset-port.dtsi"
#define PORT_VCID 1
#define DES_LINK 1
#define PORT_IDX 9
#define POSITION PORT_IDX
#define ENDPOINT_A 18
#define ENDPOINT_B 19
#define SER_BUS 49
#define ATR_SER_ADDR 49
#define ATR_IMG_ADDR 69
#define ATR_GPIO_EXP_ADDR 79
#define ATR_EEPROM_ADDR 6D

#include "d3-nxc-fpdlink-cameras.dtsi"

/* Port 2 */
#include "d3-reset-port.dtsi"
#define PORT_VCID 2
#define DES_LINK 2
#define PORT_IDX 10
#define POSITION A
#define ENDPOINT_A 20
#define ENDPOINT_B 21
#define SER_BUS 50
#define ATR_SER_ADDR 4a
#define ATR_IMG_ADDR 6a
#define ATR_GPIO_EXP_ADDR 7a
#define ATR_EEPROM_ADDR 6E

#include "d3-nxc-fpdlink-cameras.dtsi"

/* Port 3 */
#include "d3-reset-port.dtsi"
#define PORT_VCID 3
#define DES_LINK 3
#define PORT_IDX 11
#define POSITION B
#define ENDPOINT_A 22
#define ENDPOINT_B 23
#define SER_BUS 51
#define ATR_SER_ADDR 4b
#define ATR_IMG_ADDR 6b
#define ATR_GPIO_EXP_ADDR 7b
#define ATR_EEPROM_ADDR 6F

#include "d3-nxc-fpdlink-cameras.dtsi"
