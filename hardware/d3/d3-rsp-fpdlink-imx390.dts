/*
 * Copyright (c) 2018-2019, D3 Engineering.  All rights reserved.
 *
 * This program is free software; you can redistribute it and/or modify
 * it under the terms of the GNU General Public License as published by
 * the Free Software Foundation; version 2 of the License.
 *
 * This program is distributed in the hope that it will be useful, but WITHOUT
 * ANY WARRANTY; without even the implied warranty of MERCHANTABILITY or
 * FITNESS FOR A PARTICULAR PURPOSE.  See the GNU General Public License for
 * more details.
 */
#include "tegra186-quill-p3310-1000-c03-00-base.dts"
#include <dt-bindings/media/camera.h>
#include "dt-bindings/clock/tegra186-clock.h"
#include "t18x-common-platforms/tegra186-hdmi.dtsi"
#include "tegra186-soc/tegra186-camera.dtsi"

#define CAMERA_IMX390
#include "d3-rsp-fpdlink.dtsi"
#include "d3-jetson-bsp-version.dtsi"

/ {
	nvidia,dtsfilename = __FILE__;
	nvidia,dtbbuildtime = __DATE__, __TIME__;
	d3,jetson-bsp-version = D3_JETSON_BSP_VERSION;
	d3,jetson-bsp-build-id = D3_JETSON_BSP_BUILDID;
};
