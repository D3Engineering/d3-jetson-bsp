/*
 * Copyright (c) 2018-2019, D3 Engineering.  All rights reserved.
 *
 * This program is free software; you can redistribute it and/or modify
 * it under the terms of the GNU General Public License as published by
 * the Free Software Foundation; version 2 of the License.
 *
 * This program is distributed in the hope that it will be useful, but WITHOUT
 * ANY WARRANTY; without even the implied warranty of MERCHANTABILITY or
 * FITNESS FOR A PARTICULAR PURPOSE.  See the GNU General Public License for
 * more details.
 */
#include "../nvidia/platform/t23x/concord/kernel-dts/tegra234-p3701-0000-p3737-0000.dts"

#define TEGRA_MAIN_GPIO TEGRA234_MAIN_GPIO
#define TEGRA_MAIN_GPIO_RANGE TEGRA234_MAIN_GPIO_RANGE
#define TEGRA_MAIN_GPIO_BASE TEGRA234_MAIN_GPIO_BASE
#define TEGRA_AON_GPIO TEGRA234_AON_GPIO
#define TEGRA_AON_GPIO_RANGE TEGRA234_AON_GPIO_RANGE
#define TEGRA_AON_GPIO_BASE TEGRA234_AON_GPIO_BASE

/ {
    chosen
    {
        bootargs = "root=/dev/mmcblk0p1 rw rootwait console=ttyTCU0,115200 console=ttyAMA0,115200 console=tty0 fbcon=map:0 net.ifnames=0 rootfstype=ext4 ";
        board-has-eeprom;
    };
};
