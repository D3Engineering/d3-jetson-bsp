/*
 * Copyright (c) 2018-2019, D3 Engineering.  All rights reserved.
 *
 * This program is free software; you can redistribute it and/or modify
 * it under the terms of the GNU General Public License as published by
 * the Free Software Foundation; version 2 of the License.
 *
 * This program is distributed in the hope that it will be useful, but WITHOUT
 * ANY WARRANTY; without even the implied warranty of MERCHANTABILITY or
 * FITNESS FOR A PARTICULAR PURPOSE.  See the GNU General Public License for
 * more details.
 */
#include "d3-cam-reset.dtsi"

#define DES_LINK fpd_link0
#define DES_LINK_PATH /proc/device-tree/i2c@3180000/mux@70/i2c@0/deserializer@32/link@0
#define SER_ADDR 3c
#define IMG_BUS 9
#define IMG_ADDR 48
#define CSI_PORT 0
#define CSI_LANES 4
#define STATUS okay
#define IOVDD_SUPPLY <&vdd_1v8_ap>
#define AVDD_SUPPLY <&vdd_1v8_ap>
#define TEGRA_SINTERFACE serial_a
/* A is CSI_PORT * 2 */
#define ENDPOINT_A 0
/* B is A+1 */
#define ENDPOINT_B 1
#define POSITION rear
#define ORIENTATION 1

#ifdef CAMERA_OV10640
#   include "d3-cam-ov10640-template.dtsi"
#endif

#ifdef CAMERA_IMX390
#   include "d3-cam-imx390-template.dtsi"
#endif

#ifdef CAMERA_IMX390RCM
#   include "d3-cam-imx390rcm-template.dtsi"
#endif

#ifdef CAMERA_VG6768
#   include "d3-cam-vg6768-template.dtsi"
#endif
