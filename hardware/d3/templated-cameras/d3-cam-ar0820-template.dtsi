/*
 * Copyright (c) 2023, Define Design Deploy Corp. All rights reserved.
 *
 * This program is free software; you can redistribute it and/or modify
 * it under the terms of the GNU General Public License as published by
 * the Free Software Foundation; version 2 of the License.
 *
 * This program is distributed in the hope that it will be useful, but WITHOUT
 * ANY WARRANTY; without even the implied warranty of MERCHANTABILITY or
 * FITNESS FOR A PARTICULAR PURPOSE.  See the GNU General Public License for
 * more details.
 */

#include "d3-reset-cam.dtsi"
#define CAM_MODEL ar0820
#define IMG_ADDR_PHYSICAL 10
#include "d3-cam-common.dtsi"
#include "d3-check-cam.dtsi"

&SER_LINK_NODE {
	CAM_NODE: CAM_NODE_NAME {
		status = STR(STATUS);
		compatible = "d3,ar0820";
		reg = <HEX_PREFIX(IMG_ADDR)>;
		devnode = STR(CONCAT_2(video,PORT_IDX));
		physical-addr = <HEX_PREFIX(IMG_ADDR_PHYSICAL)>;

		physical_w = "27.30";
		physical_h = "21.80";
		sensor_model = "ar0820";
		use_decibel_gain = "false";
		mclk = "extperiph1";

		#include "d3-cam-ar0820-modes.dtsi"
	};

};


#include "d3-overlays-cam.dtsi"
