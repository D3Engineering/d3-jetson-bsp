/*
 * Copyright (c) 2023, Define Design Deploy Corp. All rights reserved.
 *
 * This program is free software; you can redistribute it and/or modify
 * it under the terms of the GNU General Public License as published by
 * the Free Software Foundation; version 2 of the License.
 *
 * This program is distributed in the hope that it will be useful, but WITHOUT
 * ANY WARRANTY; without even the implied warranty of MERCHANTABILITY or
 * FITNESS FOR A PARTICULAR PURPOSE.  See the GNU General Public License for
 * more details.
 */

mode0 {
	mclk_khz = "25000";
	num_lanes = STR(CSI_LANES);
	tegra_sinterface = STR(TEGRA_SINTERFACE);
	discontinuous_clk = "no";
	dpcm_enable = "false";
	cil_settletime = "0";
	csi_pixel_bit_depth = "12";
	pixel_phase = "rggb";
	active_w = "1920";
	active_h = "1080";
	readout_orientation = "0";
	inherent_gain = "1";
	serdes_pix_clk_hz = "500000000";
	pix_clk_hz = "148500000";
	embedded_metadata_height = "1";
	min_hdr_ratio = "64.0";
	max_hdr_ratio = "64.0";
	vc_id = STR(PORT_VCID);

	mode_type = "bayer";
	line_length = "4400";
	min_gain_val = "0";
	max_gain_val = "30";
	min_framerate = "30";
	max_framerate = "30";
	min_exp_time = "30";
	max_exp_time = "33333";
	dynamic_pixel_bit_depth = "12";
	num_control_point = "0";
};

mode1 {
	mclk_khz = "25000";
	num_lanes = STR(CSI_LANES);
	tegra_sinterface = STR(TEGRA_SINTERFACE);
	discontinuous_clk = "no";
	dpcm_enable = "false";
	cil_settletime = "0";
	csi_pixel_bit_depth = "12";
	pixel_phase = "rggb";
	active_w = "1920";
	active_h = "1080";
	readout_orientation = "0";
	inherent_gain = "1";
	serdes_pix_clk_hz = "500000000";
	pix_clk_hz = "148500000";
	embedded_metadata_height = "1";
	min_hdr_ratio = "64.0";
	max_hdr_ratio = "64.0";
	vc_id = STR(PORT_VCID);

	mode_type = "bayer_wdr_pwl";

	line_length = "4400";

	min_gain_val = "8.4";
	max_gain_val = "24";

	min_framerate = "30";
	max_framerate = "30";

	/* Units are microseconds */
	min_exp_time = "2000";
	max_exp_time = "33000";

	/* Xavier supports up to 20bpp, Tx2 supports up to 24bpp */
	dynamic_pixel_bit_depth = "20";
	/* Xavier supports up to 9 control points. */
	num_control_point = "9";
	control_point_x_0 = "0";
	control_point_y_0 = "0";
	control_point_x_1="479";
	control_point_y_1="479";
	control_point_x_2="1438";
	control_point_y_2="837";
	control_point_x_3="4315";
	control_point_y_3="1238";
	control_point_x_4="12945";
	control_point_y_4="1688";
	control_point_x_5="38836";
	control_point_y_5="2191";
	control_point_x_6="116508";
	control_point_y_6="2755";
	control_point_x_7="349525";
	control_point_y_7="3387";
	control_point_x_8="1048575";
	control_point_y_8="4095";
};