/*
 * Copyright (c) 2018-2021, D3 Engineering. All rights reserved.
 *
 * This program is free software; you can redistribute it and/or modify
 * it under the terms of the GNU General Public License as published by
 * the Free Software Foundation; version 2 of the License.
 *
 * This program is distributed in the hope that it will be useful, but WITHOUT
 * ANY WARRANTY; without even the implied warranty of MERCHANTABILITY or
 * FITNESS FOR A PARTICULAR PURPOSE.  See the GNU General Public License for
 * more details.
 */

#include "d3-reset-cam.dtsi"
#define CAM_MODEL imx490fpd
#define DRIVER_NAME imx490
#define IMG_ADDR_PHYSICAL 1a
#include "d3-cam-common.dtsi"
#include "d3-check-cam.dtsi"

#define SER_NODE_OVERLAY                        \
    gpio-rmten = <0x0>;                         \
    gpio-in-en = <0x0>;                         \
    hs-clk-div = <0x1>;                         \
    div-m-val = <0x1>;                          \
    div-n-val = <0x28>;

&SER_LINK_NODE {
	CAM_NODE: CAM_NODE_NAME {
		compatible = "d3,imx490";

		mclk = "extperiph1";
		physical_w = "15.35";
		physical_h = "11.68";
		sensor_model = "imx490";
		use_decibel_gain = "true";
		use_sensor_mode_id = "true";

		reset_gpio = <&SER_GPIO_NODE 0 GPIO_ACTIVE_HIGH>;

#		include "d3-cam-imx490-modes.dtsi"
	};
};

#include "d3-overlays-cam.dtsi"
