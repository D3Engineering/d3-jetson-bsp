/*
 * Copyright (c) 2018-2019, D3 Engineering. All rights reserved.
 *
 * This program is free software; you can redistribute it and/or modify
 * it under the terms of the GNU General Public License as published by
 * the Free Software Foundation; version 2 of the License.
 *
 * This program is distributed in the hope that it will be useful, but WITHOUT
 * ANY WARRANTY; without even the implied warranty of MERCHANTABILITY or
 * FITNESS FOR A PARTICULAR PURPOSE.  See the GNU General Public License for
 * more details.
 */

#include "d3-reset-cam.dtsi"
#define CAM_MODEL imx390
#define IMG_ADDR_PHYSICAL 21
#include "d3-cam-common.dtsi"
#include "d3-check-cam.dtsi"

/* Target hardware: 3085 Serializer board + 3106 IMX390 w/ external clock (from
 * ub953)
 */

#define SER_NODE_OVERLAY			\
hs-clk-div = <0x4>;				\
div-m-val = <0x1b>;				\
div-n-val = <0xfa>;

&SER_LINK_NODE {
	CAM_NODE: CAM_NODE_NAME {
		compatible = "d3,imx390";

		mclk = "extperiph1";
		physical_w = "5.37";
		physical_h = "4.04";
		sensor_model = "imx390";
		use_decibel_gain = "true";
		use_sensor_mode_id = "true";
		vflip;
		hflip;

		set_mode_delay_ms = "500";

		reset-gpios = <&SER_GPIO_EXP_NODE 0 GPIO_ACTIVE_HIGH>;

#		include "d3-cam-imx390-modes.dtsi"
	};
};

#include "d3-overlays-cam.dtsi"

&_CAM_NODE_DES_LINK_OVERLAY(CAM_MODEL,PORT_IDX){
	SER_GPIO_EXP_NODE_NAME {
		status = "okay";
	};
};
