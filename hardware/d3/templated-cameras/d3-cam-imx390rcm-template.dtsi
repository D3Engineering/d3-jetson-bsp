/*
 * Copyright (c) 2018-2019, D3 Engineering. All rights reserved.
 *
 * This program is free software; you can redistribute it and/or modify
 * it under the terms of the GNU General Public License as published by
 * the Free Software Foundation; version 2 of the License.
 *
 * This program is distributed in the hope that it will be useful, but WITHOUT
 * ANY WARRANTY; without even the implied warranty of MERCHANTABILITY or
 * FITNESS FOR A PARTICULAR PURPOSE.  See the GNU General Public License for
 * more details.
 */

#include "d3-reset-cam.dtsi"
#define CAM_MODEL imx390rcm
#define DRIVER_NAME imx390
#define IMG_ADDR_PHYSICAL 1a
#include "d3-cam-common.dtsi"
#include "d3-check-cam.dtsi"

/*
 * - hs-clk-div, div-?-val: When deserializer has a 25MHz clock,
 *   clkout = 25*160*1/4*m*1/n = 25 * 160 * 1/4 * 1 * 1/37 = 27.027027... MHz
 * - gpio-rmten: 0x00 = No pins are controlled remotely, not even frame sync.
 *   This takes effect at probe time.  Frame sync is enabled at runtime by
 *   fsync-gpio.
 * - gpio-out-src: (0x02 = nReset held inactive (not in reset)) |
 *                 (0x01 = FSYNC high when not in frame-sync mode)
 * - gpio-out-en: (0x02 = nReset) | (0x01 = FSYNC)
 * - gpio-in-en: 0x00 = no GPIOs are inputs
 * - fsync-gpio: 0 = GPIO0 is controlled remotely.  Just like gpio-rmten,
 *   except that this takes effect at runtime, when a sensor driver calls
 *   ub953_set_frame_sync_enable().
 */
#define SER_NODE_OVERLAY	\
gpio-rmten = <0x0>; \
gpio-out-src = <0x3>; \
gpio-out-en = <0xF>; \
gpio-in-en = <0x0>; \
hs-clk-div = <0x2>; \
div-m-val = <0x1>; \
div-n-val = <0x25>;


&SER_LINK_NODE {
	CAM_NODE: CAM_NODE_NAME {
		compatible = "d3,imx390";

		mclk = "extperiph1";
		physical_w = "5.37";
		physical_h = "4.04";
		sensor_model = "imx390";
		use_decibel_gain = "true";
		use_sensor_mode_id = "true";

#		include "d3-cam-imx390-modes.dtsi"
	};
};

#include "d3-overlays-cam.dtsi"
