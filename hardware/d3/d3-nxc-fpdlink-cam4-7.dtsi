/*
 * Copyright (c) 2020, D3 Engineering. All rights reserved.
 *
 * This program is free software; you can redistribute it and/or modify
 * it under the terms of the GNU General Public License as published by
 * the Free Software Foundation; version 2 of the License.
 *
 * This program is distributed in the hope that it will be useful, but WITHOUT
 * ANY WARRANTY; without even the implied warranty of MERCHANTABILITY or
 * FITNESS FOR A PARTICULAR PURPOSE.  See the GNU General Public License for
 * more details.
 */

#include "d3-reset-full.dtsi"

#define STATUS disabled
#define ORIENTATION 1

#define IOVDD_SUPPLY <&p3668_vdd_1v8_sd>
#define AVDD_SUPPLY <&p3668_vdd_1v8_sd>
#define RESET_PIN <&nxc_fg 96 GPIO_ACTIVE_LOW>

#define TEGRA_SINTERFACE serial_c
#define CSI_PORT 2
#define CSI_LANES 4
#define VI_INPUT_STREAM 2

#define I2C_BASE_PATH /proc/device-tree/i2c@3180000/tca9546@77/i2c@1
#define DES_BUS 2
#define DES_BUS_NODE i2c_mux_bus_1
#define DES_ADDR 34
#define EEPROM_ADDR 54

#include "templated-deserializers/d3-des-ub960-template.dtsi"

/* Port 0 */
#include "d3-reset-port.dtsi"
#define PORT_VCID 0
#define DES_LINK 0
#define PORT_IDX 4
#define POSITION PORT_IDX
#define ENDPOINT_A 8
#define ENDPOINT_B 9
#define SER_BUS 44
#define ATR_SER_ADDR 44
#define ATR_IMG_ADDR 64
#define ATR_GPIO_EXP_ADDR 74
#define ATR_EEPROM_ADDR 5C

#include "d3-nxc-fpdlink-cameras.dtsi"

/* Port 1 */
#include "d3-reset-port.dtsi"
#define PORT_VCID 1
#define DES_LINK 1
#define PORT_IDX 5
#define POSITION PORT_IDX
#define ENDPOINT_A 10
#define ENDPOINT_B 11
#define SER_BUS 45
#define ATR_SER_ADDR 45
#define ATR_IMG_ADDR 65
#define ATR_GPIO_EXP_ADDR 75
#define ATR_EEPROM_ADDR 5D

#include "d3-nxc-fpdlink-cameras.dtsi"

/* Port 2 */
#include "d3-reset-port.dtsi"
#define PORT_VCID 2
#define DES_LINK 2
#define PORT_IDX 6
#define POSITION PORT_IDX
#define ENDPOINT_A 12
#define ENDPOINT_B 13
#define SER_BUS 46
#define ATR_SER_ADDR 46
#define ATR_IMG_ADDR 66
#define ATR_GPIO_EXP_ADDR 76
#define ATR_EEPROM_ADDR 5E

#include "d3-nxc-fpdlink-cameras.dtsi"

/* Port 3 */
#include "d3-reset-port.dtsi"
#define PORT_VCID 3
#define DES_LINK 3
#define PORT_IDX 7
#define POSITION PORT_IDX
#define ENDPOINT_A 14
#define ENDPOINT_B 15
#define SER_BUS 47
#define ATR_SER_ADDR 47
#define ATR_IMG_ADDR 67
#define ATR_GPIO_EXP_ADDR 77
#define ATR_EEPROM_ADDR 5F

#include "d3-nxc-fpdlink-cameras.dtsi"
