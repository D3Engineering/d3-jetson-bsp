/*
 * Copyright (c) 2018-2019, D3 Engineering.  All rights reserved.
 *
 * This program is free software; you can redistribute it and/or modify
 * it under the terms of the GNU General Public License as published by
 * the Free Software Foundation; version 2 of the License.
 *
 * This program is distributed in the hope that it will be useful, but WITHOUT
 * ANY WARRANTY; without even the implied warranty of MERCHANTABILITY or
 * FITNESS FOR A PARTICULAR PURPOSE.  See the GNU General Public License for
 * more details.
 */

#include "d3-reset-full.dtsi"

/* General ports configuration */
#define STATUS disabled
#define ORIENTATION 1

#define IOVDD_SUPPLY <&p2822_vdd_1v8_cvb>
#define AVDD_SUPPLY <&fpd_vdd_4_7>
#define RESET_PIN <&gpio_i2c_3_74 12 GPIO_ACTIVE_LOW>

#define TEGRA_SINTERFACE serial_c
#define CSI_PORT 2
#define CSI_LANES 4

#define I2C_ADDR 3180000
#define I2C_BASE_PATH CONCAT_2(/proc/device-tree/i2c@,I2C_ADDR)

#define EEPROM_ADDR 54
#define IMG_BUS 2

/* UB960 */
#define DES_ADDR 32
#include "templated-deserializers/d3-des-ub960-template.dtsi"

/* Port 0 */
#include "d3-reset-port.dtsi"

#define PORT_VCID 0
#define DES_LINK 0
#define PORT_IDX 4
#define POSITION PORT_IDX
#define ENDPOINT_A 8
#define ENDPOINT_B 9
#define SER_ADDR 44
#define IMG_ADDR 64

#include "d3-2xocto-cameras.dtsi"

/* Port 1 */
#include "d3-reset-port.dtsi"

#define PORT_VCID 1
#define DES_LINK 1
#define PORT_IDX 5
#define POSITION PORT_IDX
#define ENDPOINT_A 10
#define ENDPOINT_B 11
#define SER_ADDR 45
#define IMG_ADDR 65

#include "d3-2xocto-cameras.dtsi"

/* Port 2 */
#include "d3-reset-port.dtsi"

#define PORT_VCID 2
#define DES_LINK 2
#define PORT_IDX 6
#define POSITION PORT_IDX
#define ENDPOINT_A 12
#define ENDPOINT_B 13
#define SER_ADDR 46
#define IMG_ADDR 66

#include "d3-2xocto-cameras.dtsi"

/* Port 3 */
#include "d3-reset-port.dtsi"

#define PORT_VCID 3
#define DES_LINK 3
#define PORT_IDX 7
#define POSITION PORT_IDX
#define ENDPOINT_A 14
#define ENDPOINT_B 15
#define SER_ADDR 47
#define IMG_ADDR 67

#include "d3-2xocto-cameras.dtsi"
