/*
 * Copyright (c) 2018-2019, D3 Engineering.  All rights reserved.
 *
 * This program is free software; you can redistribute it and/or modify
 * it under the terms of the GNU General Public License as published by
 * the Free Software Foundation; version 2 of the License.
 *
 * This program is distributed in the hope that it will be useful, but WITHOUT
 * ANY WARRANTY; without even the implied warranty of MERCHANTABILITY or
 * FITNESS FOR A PARTICULAR PURPOSE.  See the GNU General Public License for
 * more details.
 */

#include "d3-reset-full.dtsi"

/* General ports configuration */
#define STATUS disabled
#define ORIENTATION 1

#define IOVDD_SUPPLY <&p2822_vdd_1v8_cvb>
#define AVDD_SUPPLY <&fpd_vdd_0_3>
#define RESET_PIN <&gpio_i2c_3_74 13 GPIO_ACTIVE_LOW>

#define TEGRA_SINTERFACE serial_a
#define CSI_PORT 0
#define CSI_LANES 4

#define I2C_ADDR 3180000
#define I2C_BASE_PATH CONCAT_2(/proc/device-tree/i2c@,I2C_ADDR)

#define EEPROM_ADDR 54
#define IMG_BUS 2

/* UB960 */
#define DES_ADDR 30
#include "templated-deserializers/d3-des-ub960-template.dtsi"

/* Port 0 */
#include "d3-reset-port.dtsi"

#define PORT_VCID 0
#define DES_LINK 0
#define PORT_IDX 0
#define POSITION PORT_IDX
#define ENDPOINT_A 0
#define ENDPOINT_B 1
#define SER_ADDR 40
#define IMG_ADDR 60

#include "d3-2xocto-cameras.dtsi"

/* Port 1 */
#include "d3-reset-port.dtsi"

#define PORT_VCID 1
#define DES_LINK 1
#define PORT_IDX 1
#define POSITION PORT_IDX
#define ENDPOINT_A 2
#define ENDPOINT_B 3
#define SER_ADDR 41
#define IMG_ADDR 61

#include "d3-2xocto-cameras.dtsi"

/* Port 2 */
#include "d3-reset-port.dtsi"

#define PORT_VCID 2
#define DES_LINK 2
#define PORT_IDX 2
#define POSITION PORT_IDX
#define ENDPOINT_A 4
#define ENDPOINT_B 5
#define SER_ADDR 42
#define IMG_ADDR 62

#include "d3-2xocto-cameras.dtsi"

/* Port 3 */
#include "d3-reset-port.dtsi"

#define PORT_VCID 3
#define DES_LINK 3
#define PORT_IDX 3
#define POSITION PORT_IDX
#define ENDPOINT_A 6
#define ENDPOINT_B 7
#define SER_ADDR 43
#define IMG_ADDR 63

#include "d3-2xocto-cameras.dtsi"
