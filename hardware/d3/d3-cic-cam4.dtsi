/*
 * Copyright (c) 2019, D3 Engineering. All rights reserved.
 *
 * This program is free software; you can redistribute it and/or modify
 * it under the terms of the GNU General Public License as published by
 * the Free Software Foundation; version 2 of the License.
 *
 * This program is distributed in the hope that it will be useful, but WITHOUT
 * ANY WARRANTY; without even the implied warranty of MERCHANTABILITY or
 * FITNESS FOR A PARTICULAR PURPOSE.  See the GNU General Public License for
 * more details.
 */

#include "d3-reset-full.dtsi"

#define DES_NODE max9296
#define DES_PATH /proc/device-tree/i2c@3180000/mux@70/i2c@1/max9296@48
#define SER_ADDR 62
#define IMG_BUS 40
#define IMG_ADDR 10
#define CSI_PORT 2
#define CSI_LANES 4
//space for IOVDD_SUPPLY if needed
//space for AVDD_SUPPLY if needed
#define STATUS disabled
#define TEGRA_SINTERFACE serial_c
#define ORIENTATION 1
#define GMSL_RESET_BIT_RATES <3000 187>
#define EEPROM_ADDR 54

/* Port 4 */
#include "d3-reset-port.dtsi"

#define PORT_VCID 0
#define DES_LINK 0
#define PORT_IDX 4
#define POSITION PORT_IDX
#define ENDPOINT_A 8
#define ENDPOINT_B 9
#define SER_ADDR 62
#define IMG_ADDR 10

#include "d3-cic-gmsl-cameras.dtsi"

#if 0
/* Port 5 */
#include "d3-reset-port.dtsi"

#define PORT_VCID 0
#define DES_LINK 0
#define PORT_IDX 5
#define POSITION PORT_IDX
#define ENDPOINT_A 10
#define ENDPOINT_B 11
#define SER_ADDR 60
#define IMG_ADDR 11

#include "d3-cic-gmsl-cameras.dtsi"
#endif

/* NOTE: valid serializer addresses according to max9296 are limited to 0x40, 0x42, 0x60 and 0x62 */
