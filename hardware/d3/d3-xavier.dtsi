/*
 * Copyright (c) 2018-2019, D3 Engineering.  All rights reserved.
 *
 * This program is free software; you can redistribute it and/or modify
 * it under the terms of the GNU General Public License as published by
 * the Free Software Foundation; version 2 of the License.
 *
 * This program is distributed in the hope that it will be useful, but WITHOUT
 * ANY WARRANTY; without even the implied warranty of MERCHANTABILITY or
 * FITNESS FOR A PARTICULAR PURPOSE.  See the GNU General Public License for
 * more details.
 */
#include "../nvidia/platform/t19x/galen/kernel-dts/tegra194-p2888-0001-p2822-0000.dts"

#define TEGRA_MAIN_GPIO TEGRA194_MAIN_GPIO
#define TEGRA_MAIN_GPIO_RANGE TEGRA194_MAIN_GPIO_RANGE
#define TEGRA_MAIN_GPIO_BASE TEGRA194_MAIN_GPIO_BASE
#define TEGRA_AON_GPIO TEGRA194_AON_GPIO
#define TEGRA_AON_GPIO_RANGE TEGRA194_AON_GPIO_RANGE
#define TEGRA_AON_GPIO_BASE TEGRA194_AON_GPIO_BASE
#define XAVIER

/ {
    chosen
    {
        bootargs = "root=/dev/mmcblk0p1 rw rootwait console=ttyTCU0,115200n8 console=tty0 fbcon=map:0 net.ifnames=0 rootfstype=ext4  ";
        board-has-eeprom;
    };
};
