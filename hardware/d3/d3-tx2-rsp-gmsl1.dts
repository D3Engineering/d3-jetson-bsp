/*
 * Copyright (c) 2019, D3 Engineering. All rights reserved.
 *
 * This program is free software; you can redistribute it and/or modify
 * it under the terms of the GNU General Public License as published by
 * the Free Software Foundation; version 2 of the License.
 *
 * This program is distributed in the hope that it will be useful, but WITHOUT
 * ANY WARRANTY; without even the implied warranty of MERCHANTABILITY or
 * FITNESS FOR A PARTICULAR PURPOSE.  See the GNU General Public License for
 * more details.
 */

/*
 * Device tree for the GMSL version of the RSP board
 * Include:
 *  - the common parts of the base board (d3-rsp-dtsi)
 *  - the GMSL deserializers (d3-rsp-gmsl-des.dtsi)
 *  - the camera modules
 */

#include "d3-string-utils.dtsi"

#define D3_BOARD_RSP_GMSL1
#include "d3-tx2-rsp.dtsi"
#include "d3-rsp-cam0.dtsi"
#include "d3-rsp-cam1.dtsi"
#include "d3-rsp-cam2.dtsi"
#include "d3-rsp-cam3.dtsi"
#include "d3-rsp-cam4.dtsi"
#include "d3-rsp-cam5.dtsi"

#include "d3-jetson-bsp-version.dtsi"

/ {
	nvidia,dtsfilename = __FILE__;
	nvidia,dtbbuildtime = __DATE__, __TIME__;
	d3,dts-description = "DESC<DesignCore Nvidia Jetson RSP-TX2 GMSL1>DESC";
	d3,jetson-bsp-version = D3_JETSON_BSP_VERSION;
	d3,jetson-bsp-build-id = D3_JETSON_BSP_BUILDID;
};
