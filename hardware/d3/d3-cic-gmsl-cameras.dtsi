/*
 * Copyright (c) 2018-2019, D3 Engineering.  All rights reserved.
 *
 * This program is free software; you can redistribute it and/or modify
 * it under the terms of the GNU General Public License as published by
 * the Free Software Foundation; version 2 of the License.
 *
 * This program is distributed in the hope that it will be useful, but WITHOUT
 * ANY WARRANTY; without even the implied warranty of MERCHANTABILITY or
 * FITNESS FOR A PARTICULAR PURPOSE.  See the GNU General Public License for
 * more details.
 */

/* MAX9295 */
#include "templated-serializers/d3-ser-max9295-template.dtsi"

/* Possible Cams*/
#include "d3-tegra-nvcsi.dtsi"
#include "templated-cameras/d3-cam-ar0820-template.dtsi"
