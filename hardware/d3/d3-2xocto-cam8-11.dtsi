/*
 * Copyright (c) 2018-2019, D3 Engineering.  All rights reserved.
 *
 * This program is free software; you can redistribute it and/or modify
 * it under the terms of the GNU General Public License as published by
 * the Free Software Foundation; version 2 of the License.
 *
 * This program is distributed in the hope that it will be useful, but WITHOUT
 * ANY WARRANTY; without even the implied warranty of MERCHANTABILITY or
 * FITNESS FOR A PARTICULAR PURPOSE.  See the GNU General Public License for
 * more details.
 */

#include "d3-reset-full.dtsi"

/* General ports configuration */
#define STATUS disabled
#define ORIENTATION 1

#define IOVDD_SUPPLY <&p2822_vdd_1v8_cvb>
#define AVDD_SUPPLY <&fpd_vdd_8_11>
#define RESET_PIN <&gpio_i2c_3_74 14 GPIO_ACTIVE_LOW>

#define TEGRA_SINTERFACE serial_e
#define CSI_PORT 4
#define CSI_LANES 4

#define I2C_ADDR 3180000
#define I2C_BASE_PATH CONCAT_2(/proc/device-tree/i2c@,I2C_ADDR)

#define EEPROM_ADDR 54
#define IMG_BUS 2

/* UB960 */
#define DES_ADDR 34
#include "templated-deserializers/d3-des-ub960-template.dtsi"

/* Port 0 */
#include "d3-reset-port.dtsi"

#define PORT_VCID 0
#define DES_LINK 0
#define PORT_IDX 8
#define POSITION 8
#define ENDPOINT_A 16
#define ENDPOINT_B 17
#define SER_ADDR 48
#define IMG_ADDR 68

#include "d3-2xocto-cameras.dtsi"

/* Port 1 */
#include "d3-reset-port.dtsi"

#define PORT_VCID 1
#define DES_LINK 1
#define PORT_IDX 9
#define POSITION 9
#define ENDPOINT_A 18
#define ENDPOINT_B 19
#define SER_ADDR 49
#define IMG_ADDR 69

#include "d3-2xocto-cameras.dtsi"

/* Port 2 */
#include "d3-reset-port.dtsi"

#define PORT_VCID 2
#define DES_LINK 2
#define PORT_IDX 10
#define POSITION A
#define ENDPOINT_A 20
#define ENDPOINT_B 21
#define SER_ADDR 4a
#define IMG_ADDR 6a

#include "d3-2xocto-cameras.dtsi"

/* Port 3 */
#include "d3-reset-port.dtsi"

#define PORT_VCID 3
#define DES_LINK 3
#define PORT_IDX 11
#define POSITION B
#define ENDPOINT_A 22
#define ENDPOINT_B 23
#define SER_ADDR 4b
#define IMG_ADDR 6b

#include "d3-2xocto-cameras.dtsi"
