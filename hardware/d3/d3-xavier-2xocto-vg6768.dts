/*
 * Copyright (c) 2018-2019, D3 Engineering.  All rights reserved.
 *
 * This program is free software; you can redistribute it and/or modify
 * it under the terms of the GNU General Public License as published by
 * the Free Software Foundation; version 2 of the License.
 *
 * This program is distributed in the hope that it will be useful, but WITHOUT
 * ANY WARRANTY; without even the implied warranty of MERCHANTABILITY or
 * FITNESS FOR A PARTICULAR PURPOSE.  See the GNU General Public License for
 * more details.
 */

#include "d3-xavier-2xocto.dts"
#include "d3-jetson-bsp-version.dtsi"

/ {
	nvidia,dtsfilename = __FILE__;
	nvidia,dtbbuildtime = __DATE__, __TIME__;
	d3,jetson-bsp-version = D3_JETSON_BSP_VERSION;
	d3,jetson-bsp-build-id = D3_JETSON_BSP_BUILDID;
	overlay-loader {
		active_overlays = "vg6768_0,vg6768_1,vg6768_2,vg6768_3";
	};
};
