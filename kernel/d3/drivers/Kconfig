## kernel/d3/drivers/d3/Kconfig
```kconfig
menu "D3 Drivers"
  source "drivers/d3/build-id/Kconfig"
  source "drivers/d3/early-at24/Kconfig"
  source "drivers/d3/config-eeprom/Kconfig"
  source "drivers/d3/overlay-loader/Kconfig"
  source "drivers/d3/ub960/Kconfig"
  source "drivers/d3/ub953/Kconfig"
# source "drivers/d3/max9296/Kconfig"
  source "drivers/d3/imx390/Kconfig"
  source "drivers/d3/imx490/Kconfig"
  source "drivers/d3/ar0820/Kconfig"
  source "drivers/d3/ov10640/Kconfig"
  source "drivers/d3/d3fixedpt/Kconfig"
  source "drivers/d3/nxc-fpga-gpio/Kconfig"
endmenu
```

## kernel/d3/drivers/d3/ar0234/Kconfig
```kconfig
config D3_AR0234
	tristate "Enable OnSemi AR0234 CMOS Image Sensor."
	depends on LIB_CAMERA_REGISTER_ACCESS
	help
	  OnSemi AR0234 CMOS Image Sensor.
```

## kernel/d3/drivers/d3/ar0820/Kconfig
```kconfig
config D3_AR0820
	tristate "Enable OnSemi AR0820 CMOS Image Sensor."
	help
	  OnSemi AR0820 CMOS Image Sensor.
```

## kernel/d3/drivers/d3/build-id/Kconfig
```kconfig
config D3_BUILDID
	bool "Include a build identifier"
	select NVMEM
	help
        This will include a unique identifier for each build in the kernel.
```

## kernel/d3/drivers/d3/config-eeprom/Kconfig
```kconfig
config D3_CONFIG_EEPROM
	bool "Configuration EEPROM"
	depends on NVMEM
	help
	  D3 A driver that accesses a configuration EEPROM.
```

## kernel/d3/drivers/d3/d3fixedpt/Kconfig
```kconfig
config D3_FIXEDPT
	bool "Fixed-point math (S42.22)"
	help
	  A library of S42.22 fixed-point math routines.  No floating-point
	  functions are used.

config D3_FIXEDPT_STARTUP_TESTS
	bool "On startup, run some sanity tests"
	depends on D3_FIXEDPT
	help
	  The results of the tests are logged in dmesg.  This option has no
	  effect on the use of the d3fixedpt routines by other drivers.
```

## kernel/d3/drivers/d3/early-at24/Kconfig
```kconfig
config D3_EARLY_AT24
	bool "EEPROM driver for D3 CIC (AT24-compatible)"
	depends on NVMEM
	help
	  D3 Permits reading configuration from an AT24-compatible EEPROM,
	  such as the 24AA1026 on the D3 Camera Interface Card.
```

## kernel/d3/drivers/d3/imx390/Kconfig
```kconfig
config D3_IMX390
	tristate "IMX390 Camera Driver"
	help
	  D3 IMX390 Camera Driver for Nvidia Tegra systems.
config D3_IMX390_HDR_ENABLE
    bool "IMX390 HDR Mode"
    depends on D3_IMX390
    help
      Enable HDR mode for D3 imx390 driver
```

## kernel/d3/drivers/d3/imx490/Kconfig
```kconfig
config D3_IMX490
	tristate "IMX490 Camera Driver"
	select D3_FIXEDPT
	help
	  D3 IMX490 Camera Driver for Nvidia Tegra systems.
```

## kernel/d3/drivers/d3/max9296/Kconfig
```kconfig
config D3_SERDES_COMMON
	tristate "GMSL serializers/deserializers"
	help
	  Say Y here if you want to add support for the GMSL
	  serializers/deserializers.
	  If unsure, say N.

config D3_MAX9296
	tristate "MAX9296A GMSL2 Deserializer Driver"
	depends on D3_SERDES_COMMON
	help
	  Say Y here if you want to add support for the MAX9296A deserializer.
	  To compile this driver as a module, choose M here; the module will
	  be called max9296.
	  If unsure, say N.

config D3_MAX9286
	tristate "MAX9286 GMSL1 Deserializer Driver"
	depends on D3_SERDES_COMMON
	help
	  Say Y here if you want to add support for the MAX9286 deserializer.
	  To compile this driver as a module, chose M here; the module will
	  be called max9286.
	  If unsure, say N.

config D3_MAX9295
	tristate "MAX9295 GMSL2 Serializer Driver"
	depends on D3_SERDES_COMMON
	depends on D3_MAX9296
	help
	  Say Y here if you want to add support for the MAX9295 GMSL2 serializer.
	  To compile this driver as a module, chose M here; the module will
	  be called max9295.
	  If unsure, say N.

config D3_MAX96705
	tristate "MAX96705 GMSL1 Serializer Driver"
	depends on D3_SERDES_COMMON
	help
	  Say Y here if you want to add support for the MAX96705 GMSL1 serializer.
	  To compile this driver as a module, chose M here; the module will
	  be called max96705.
	  If unsure, say N.
```

## kernel/d3/drivers/d3/nxc-fpga-gpio/Kconfig
```kconfig
config D3_NXC_FPGA_GPIO
	bool "NXC FPGA GPIO Controller"
	help
	  D3 GPIO control for the D3 NX Carrier board.
```

## kernel/d3/drivers/d3/ov10640/Kconfig
```kconfig
config D3_OV10640
	depends on OF
	tristate "OV10640 Camera Driver"
	help
	  D3 OV10640 Camera Driver for Nvidia Tegra systems including Jetson Tx2.
config D3_OV10640_HDR_ENABLE
    bool "OV10640 HDR Mode"
    depends on D3_OV10640
    help
      Enable HDR mode for D3 ov10640 driver
```

## kernel/d3/drivers/d3/overlay-loader/Kconfig
```kconfig
config D3_OVERLAY_LOADER
	bool "Overlay Loader"
	help
	  D3 A driver that will apply device tree based on kernel parameters.
```

## kernel/d3/drivers/d3/ub953/Kconfig
```kconfig
config D3_UB953
	tristate "UB953 FPDLINK-III Serializer Driver"
	help
	  TI ub953 serializer (used in D3 serdes board, et. al). 
```

## kernel/d3/drivers/d3/ub960/Kconfig
```kconfig
config D3_UB960
	tristate "UB960 FPDLINK-III Deserializer Driver"
	help
	  TI ub960 deserializer (used in D3 serdes board, et. al). 

# config D3_UB960TP
# 	tristate "UB960 FPDLINK-III Test Pattern Camera Driver"
# 	help
# 	  TI ub960 deserializer (used in D3 serdes board, et. al). 
```

## kernel/d3/drivers/d3/vg6768/Kconfig
```kconfig
config D3_VG6768
	bool "ST Micro vg6768 Camera Driver"
	help
	  ST Micro vg6768 Camera Driver for Nvidia Tegra systems including Jetson Tx2.
```

## kernel/d3/lib/Kconfig
```kconfig
menu "Library routines (D3)"

config LIB_CAMERA_REGISTER_ACCESS
	bool "Routines to streamline access to camera registers"
	help
	  Includes cam_rw and reg_ctl.

endmenu
```
